## drivers/sensors/Kconfig
```kconfig
# 
# Sensors core device. 
#

config SENSORS_CORE
	tristate "Sensors core"
	help
	  Say Y here to enable debugging messages for power supply class
	  and drivers.


config SENSORS_MMC328X_MAG
	depends on I2C
	tristate "mmc328x_magnetic"
	default y
	help
	  This option enables magnetic sensors using mmc328x magnetic driver.

config SENSORS_BMA_ACCEL
	depends on I2C
	tristate "bma222 accel"
	default y
	help
	  This option enables accel sensors using bma222 accel driver.

config SENSORS_GP2A
	tristate "GP2A sensor support"
	depends on I2C=y
	default n
	help
	  If you say yes here you get support for Sharp's sensor GP2A.


config ECOMPASS
	tristate "MEMSIC eCompass Sensor Driver Support"
	depends on I2C
	default y
	help
	  If you say yes here you get support for the MEMSIC magnateic sensor
```
